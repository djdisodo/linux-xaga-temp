## drivers/dma-buf/heaps/Kconfig
```kconfig
config DMABUF_HEAPS_SYSTEM
	tristate "DMA-BUF System Heap"
	depends on DMABUF_HEAPS
	help
	  Choose this option to enable the system dmabuf heap. The system heap
	  is backed by pages from the buddy allocator. If in doubt, say Y.

config DMABUF_HEAPS_MTK_MM
	tristate "DMA-BUF MTK_MM Heap"
	depends on DMABUF_HEAPS && DMABUF_HEAPS_DEFERRED_FREE && DMABUF_HEAPS_PAGE_POOL
	help
	  Choose this option to enable the mtk_mm dmabuf heap. The mtk_mm heap
	  is backed by pages from the buddy allocator. If in doubt, say Y.

config DMABUF_HEAPS_DEBUG
	tristate "DMA-BUF debug Heap"
	depends on DMABUF_HEAPS_MTK_MM && DMABUF_HEAPS_SYSTEM
	help
	  Choose this option to enable the mtk debug heap.
	  This debug tool can be use to dump dmabuf usage for users
	  If you want use it, say Y if you are not using GKI
	  say m and add ko into your system for GKI.

config DMABUF_HEAPS_CMA
	tristate "DMA-BUF CMA Heap"
	depends on DMABUF_HEAPS && DMA_CMA
	help
	  Choose this option to enable dma-buf CMA heap. This heap is backed
	  by the Contiguous Memory Allocator (CMA). If your system has these
	  regions, you should say Y here.

config DMABUF_HEAPS_CMA_LEGACY
	bool "Legacy DMA-BUF CMA Heap"
	default y
	depends on DMABUF_HEAPS_CMA
	help
	  Add a duplicate CMA-backed dma-buf heap with legacy naming derived
	  from the CMA area's devicetree node, or "reserved" if the area is not
	  defined in the devicetree. This uses the same underlying allocator as
	  CONFIG_DMABUF_HEAPS_CMA.
```
